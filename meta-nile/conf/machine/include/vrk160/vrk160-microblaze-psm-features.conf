## meta-nile/conf/machine/include/vrk160/vrk160-microblaze-psm-features.conf
```bitbake
MACHINE_FEATURES = "cframe cfupmc common csudma emacps gpiops iicps intc iomodule ipipsu ospipsv rtcpsu sdps sysmonpsv tmr-inject tmr-manager trngpsv ttcps uartlite uartpsv usbpsu zdma"
```
